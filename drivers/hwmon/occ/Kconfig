## drivers/hwmon/occ/Kconfig
```kconfig
#
# On-Chip Controller configuration
#

config SENSORS_OCC
	tristate "POWER On-Chip Controller"
	help
	  If you say yes here you get support for monitoring the IBM POWER
	  processor sensors via the On-Chip Controller (OCC).

	  This driver can also be built as a module. If so, the module will be
	  called occ-hwmon.

config SENSORS_OCC_P8_I2C
	bool "POWER8 OCC via I2C"
	depends on I2C && SENSORS_OCC
	help
	  If you say yes here you get support for monitoring the POWER8
	  processor sensors via the OCC, from a service processor, over I2C
	  bus.

config SENSORS_OCC_P9_SBE
	bool "POWER9 OCC via SBE"
	depends on OCCFIFO && SENSORS_OCC
	help
	  If you say yes here you get support for monitoring the POWER9
	  processor sensors via the OCC, from a service processor, over SBE
	  engine on FSI bus.
```
